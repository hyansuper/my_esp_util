## sntp_srv/Kconfig
```kconfig
menu "SNTP Service"
    config SNTP_SRV_SYNC_TIMEOUT
    	int "SNTP sync timeout(ms)"
    	default 5000
    config SNTP_SRV_MAX_RETRY
    	int "Max SNTP connect retries on timeout"
    	default 6
endmenu
```
