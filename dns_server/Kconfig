## dns_server/Kconfig
```kconfig
menu "DNS server"
    config DNS_SERVER_TASK_PRIO
        int "DNS server task priority"
        default 1
endmenu
```

## http_client_util/Kconfig
```kconfig
menu "HTTP client util"
    config HTTP_CLIENT_UTIL_SKIP_COMMON_NAME_CHECK
        bool "skip server common name check"
        default n
endmenu
```

## kv/Kconfig
```kconfig
menu "KV"
    config KV_PART_CUSTOM
        bool "set custom name for nvs partition, default to project {APP_NAME}_nvs"
        default n
    config KV_PART_CUSTOM_NAME
        string "Set custom nvs partition name" if KV_PART_CUSTOM
        default "kv_nvs"
endmenu
```

## server_util/Kconfig
```kconfig
menu "HTTP server util"
    config HTTP_SERVER_UTIL_ENABLE_PROXY
        bool "compile server proxy handler"
        default n
endmenu
```

## wifi_manager/Kconfig
```kconfig
menu "Wifi manager"
    config WMGR_HOSTNAME_CUSTOM
        bool "custom name for ap mode ssid, default to project APP_NAME"
        default n
    config WMGR_HOSTNAME_CUSTOM_NAME
        string "Set both server hostname and wifi ap mode ssid" if WMGR_HOSTNAME_CUSTOM
        default LWIP_LOCAL_HOSTNAME
        help
            By default this option is same as LWIP_LOCAL_HOSTNAME
    config WMGR_APPEND_DEVICE_ID_TO_HOSTNAME
        bool "Append to hostname the last 4 hex digit of mac address as device id"
        default y
    config WMGR_CONN_MAX_RETRY
        int "wifi sta mode connection max retries"
        default 2
    config WMGR_WAIT_CONN_TIMEOUT
        int "wifi sta mode connect timeout(ms)"
        default 10000
    config WMGR_STA_RECONN_INTERVAL
        int "wifi sta mode reconnect delay(ms)"
        default 60000
    config WMGR_PROV_MAX_CLIENT
        int "provision http server max allowed client connections"
        default 3
endmenu
```

## zip/Kconfig
```kconfig
menu "ZIP"
	config ZIP_GUNZIP_CHECK_HEADER_CRC32
		bool "Check header crc32 when doing gunzip"
		default y
	config ZIP_GUNZIP_CHECK_BODY_CRC32
		bool "Check content body crc32 when doing gunzip"
		default y
		help
			Turn it off to save time.
endmenu
```
